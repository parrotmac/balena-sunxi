## layers/meta-balena-sunxi/conf/layer.conf
```bitbake
BBPATH .= ":${LAYERDIR}"

BBFILES += "${LAYERDIR}/recipes-*/*/*.bb \
            ${LAYERDIR}/recipes-*/*/*.bbappend"

BBFILE_COLLECTIONS += "balena-sunxi"
BBFILE_PATTERN_balena-sunxi := "^${LAYERDIR}/"
BBFILE_PRIORITY_balena-sunxi = "1337"

LAYERSERIES_COMPAT_balena-sunxi = "warrior"
```
